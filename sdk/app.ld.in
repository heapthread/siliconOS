/* silicon app module linker script (build_app.py fills in @BASE@) */
ENTRY(silicon_main)

SECTIONS
{
    . = @BASE@;

    .text : {
        *(.text)
        *(SORT(.text$*))
        *(.text.*)
    }

    .rdata : {
        *(.rdata)
        *(SORT(.rdata$*))
        *(.rodata)
        *(.rodata.*)
    }

    .data : {
        __ctors_start = .;
        *(.ctors)
        *(SORT(.ctors.*))
        __ctors_end = .;
        *(.data)
        *(SORT(.data$*))
        *(.bss)
        *(SORT(.bss$*))
        *(COMMON)
        . = ALIGN(16);
    }

    /DISCARD/ : {
        *(.pdata) *(.xdata) *(.edata) *(.idata*) *(.reloc)
        *(.debug*) *(.comment) *(.drectve) *(.note*) *(.eh_frame)
    }
}
